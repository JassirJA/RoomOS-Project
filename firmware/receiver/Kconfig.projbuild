## firmware/receiver/Kconfig.projbuild
```kconfig
menu "Room OS Receiver Configuration"

    config ROOM_OS_WIFI_CHANNEL
        int "Wi-Fi Channel (1-14)"
        range 1 14
        default 11
        help
            Must match the channel configured on the Room OS Transmitter.
            Defaults to channel 11.

    choice ROOM_OS_WIFI_BANDWIDTH
        prompt "Wi-Fi Channel Bandwidth"
        default ROOM_OS_WIFI_BW_HT40
        help
            Must match the bandwidth configured on the Room OS Transmitter.

        config ROOM_OS_WIFI_BW_HT20
            bool "HT20 (20 MHz, ~64 subcarriers)"

        config ROOM_OS_WIFI_BW_HT40
            bool "HT40 (40 MHz, ~128 subcarriers)"
    endchoice

    config ROOM_OS_SERIAL_BAUD
        int "Serial Port Baud Rate"
        default 921600
        help
            UART baud rate for streaming CSI frames to the laptop.
            921600 baud easily handles 100 Hz CSI packets with ~128 subcarriers.

endmenu
```

## firmware/receiver/sdkconfig.defaults
```kconfig
# Target strictly ESP32
CONFIG_IDF_TARGET="esp32"
CONFIG_IDF_TARGET_ESP32=y

# High-speed console output
CONFIG_ESP_CONSOLE_UART_DEFAULT=y
CONFIG_ESP_CONSOLE_UART_BAUDRATE=921600

# Buffer sizes for continuous high-speed packet ingestion
CONFIG_ESP32_WIFI_AMPDU_TX_ENABLED=n
CONFIG_ESP32_WIFI_AMPDU_RX_ENABLED=n
CONFIG_ESP_WIFI_STATIC_RX_BUFFER_NUM=16
CONFIG_ESP_WIFI_DYNAMIC_RX_BUFFER_NUM=32

# FreeRTOS config
CONFIG_FREERTOS_HZ=1000
```

## firmware/transmitter/Kconfig.projbuild
```kconfig
menu "Room OS Transmitter Configuration"

    config ROOM_OS_WIFI_CHANNEL
        int "Wi-Fi Channel (1-14)"
        range 1 14
        default 11
        help
            The 2.4 GHz Wi-Fi channel for transmitter and receiver.
            Defaults to channel 11. Test channels 1, 6, or 11 to determine cleanest CSI.

    choice ROOM_OS_WIFI_BANDWIDTH
        prompt "Wi-Fi Channel Bandwidth"
        default ROOM_OS_WIFI_BW_HT40
        help
            Select channel bandwidth (HT20 or HT40).
            HT40 yields more subcarriers (richer sensing profile),
            while HT20 may experience lower interference in congested bands.

        config ROOM_OS_WIFI_BW_HT20
            bool "HT20 (20 MHz, ~64 subcarriers)"

        config ROOM_OS_WIFI_BW_HT40
            bool "HT40 (40 MHz, ~128 subcarriers)"
    endchoice

    config ROOM_OS_TX_RATE_HZ
        int "Transmission Rate in Hz (Packets per second)"
        range 10 250
        default 100
        help
            Rate at which ESP-NOW packets are transmitted.
            100 Hz provides high temporal resolution for micro-motion and walking.

    config ROOM_OS_TX_POWER_MAX
        bool "Set Max Wi-Fi Tx Power (20dBm)"
        default y
        help
            Ensures strongest direct-path signal between the two ESP32 nodes.

endmenu
```
